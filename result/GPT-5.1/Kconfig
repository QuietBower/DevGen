## result/GPT-5.1/Kconfig
```kconfig
config HE
    bool
    default y if TEST_DEVICES
    depends on PCI && MSI_NONBROKEN

config WDT_PCI
    bool
    default y if TEST_DEVICES
    depends on PCI && MSI_NONBROKEN

config C6XX
    bool
    default y if TEST_DEVICES
    depends on PCI && MSI_NONBROKEN

config MYRS
    bool
    default y if TEST_DEVICES
    depends on PCI && MSI_NONBROKEN

config 8139TOO
    bool
    default y if TEST_DEVICES
    depends on PCI && MSI_NONBROKEN

config GXT4500
    bool
    default y if TEST_DEVICES
    depends on PCI && MSI_NONBROKEN

config GXFB
    bool
    default y if TEST_DEVICES
    depends on PCI && MSI_NONBROKEN

config SATA_SIL24
    bool
    default y if TEST_DEVICES
    depends on PCI && MSI_NONBROKEN

config SMTCFB
    bool
    default y if TEST_DEVICES
    depends on PCI && MSI_NONBROKEN

config IE31200_EDAC
    bool
    default y if TEST_DEVICES
    depends on PCI && MSI_NONBROKEN

config SATA_SX4
    bool
    default y if TEST_DEVICES
    depends on PCI && MSI_NONBROKEN

config MYRB
    bool
    default y if TEST_DEVICES
    depends on PCI && MSI_NONBROKEN

config ENI
    bool
    default y if TEST_DEVICES
    depends on PCI && MSI_NONBROKEN

config HISI_DMA
    bool
    default y if TEST_DEVICES
    depends on PCI && MSI_NONBROKEN

config E1000E
    bool
    default y if TEST_DEVICES
    depends on PCI && MSI_NONBROKEN

config PATA_MPIIX
    bool
    default y if TEST_DEVICES
    depends on PCI && MSI_NONBROKEN

config ARCMSR
    bool
    default y if TEST_DEVICES
    depends on PCI && MSI_NONBROKEN

config IDXD
    bool
    default y if TEST_DEVICES
    depends on PCI && MSI_NONBROKEN

config DE2104X
    bool
    default y if TEST_DEVICES
    depends on PCI && MSI_NONBROKEN

config AST
    bool
    default y if TEST_DEVICES
    depends on PCI && MSI_NONBROKEN

config DDBRIDGE
    bool
    default y if TEST_DEVICES
    depends on PCI && MSI_NONBROKEN

config 8250_MID
    bool
    default y if TEST_DEVICES
    depends on PCI && MSI_NONBROKEN

config PCWD_PCI
    bool
    default y if TEST_DEVICES
    depends on PCI && MSI_NONBROKEN

config AIC7XXX
    bool
    default y if TEST_DEVICES
    depends on PCI && MSI_NONBROKEN

config IOATDMA
    bool
    default y if TEST_DEVICES
    depends on PCI && MSI_NONBROKEN

config CB_PCIMDAS
    bool
    default y if TEST_DEVICES
    depends on PCI && MSI_NONBROKEN

config I740FB
    bool
    default y if TEST_DEVICES
    depends on PCI && MSI_NONBROKEN

config FM10K
    bool
    default y if TEST_DEVICES
    depends on PCI && MSI_NONBROKEN

config SATA_QSTOR
    bool
    default y if TEST_DEVICES
    depends on PCI && MSI_NONBROKEN

config ARKFB
    bool
    default y if TEST_DEVICES
    depends on PCI && MSI_NONBROKEN

config BNA
    bool
    default y if TEST_DEVICES
    depends on PCI && MSI_NONBROKEN

config DAQBOARD2000
    bool
    default y if TEST_DEVICES
    depends on PCI && MSI_NONBROKEN

config SM501
    bool
    default y if TEST_DEVICES
    depends on PCI && MSI_NONBROKEN

config CARMINEFB
    bool
    default y if TEST_DEVICES
    depends on PCI && MSI_NONBROKEN

config MXSER
    bool
    default y if TEST_DEVICES
    depends on PCI && MSI_NONBROKEN

config ATA_GENERIC
    bool
    default y if TEST_DEVICES
    depends on PCI && MSI_NONBROKEN

config PATA_AMD
    bool
    default y if TEST_DEVICES
    depends on PCI && MSI_NONBROKEN

config EFA
    bool
    default y if TEST_DEVICES
    depends on PCI && MSI_NONBROKEN

config COBALT
    bool
    default y if TEST_DEVICES
    depends on PCI && MSI_NONBROKEN

config SOF_AUDIO_PCI_INTEL_MTL
    bool
    default y if TEST_DEVICES
    depends on PCI && MSI_NONBROKEN

config PHANTOM
    bool
    default y if TEST_DEVICES
    depends on PCI && MSI_NONBROKEN

config R852
    bool
    default y if TEST_DEVICES
    depends on PCI && MSI_NONBROKEN

config ICOM
    bool
    default y if TEST_DEVICES
    depends on PCI && MSI_NONBROKEN

config ISCI
    bool
    default y if TEST_DEVICES
    depends on PCI && MSI_NONBROKEN

config PCH_PHUB
    bool
    default y if TEST_DEVICES
    depends on PCI && MSI_NONBROKEN

config BOCHS_DRM
    bool
    default y if TEST_DEVICES
    depends on PCI && MSI_NONBROKEN

config HPILO
    bool
    default y if TEST_DEVICES
    depends on PCI && MSI_NONBROKEN

config XHCI_HCD
    bool
    default y if TEST_DEVICES
    depends on PCI && MSI_NONBROKEN

config PATA_EFAR
    bool
    default y if TEST_DEVICES
    depends on PCI && MSI_NONBROKEN

config HISI_HPRE
    bool
    default y if TEST_DEVICES
    depends on PCI && MSI_NONBROKEN

config IFCVF
    bool
    default y if TEST_DEVICES
    depends on PCI && MSI_NONBROKEN

config COM20020
    bool
    default y if TEST_DEVICES
    depends on PCI && MSI_NONBROKEN

config NVME
    bool
    default y if TEST_DEVICES
    depends on PCI && MSI_NONBROKEN

config ERDMA
    bool
    default y if TEST_DEVICES
    depends on PCI && MSI_NONBROKEN

config INTEL_LPSS
    bool
    default y if TEST_DEVICES
    depends on PCI && MSI_NONBROKEN

config PATA_NINJA32
    bool
    default y if TEST_DEVICES
    depends on PCI && MSI_NONBROKEN

config C6XXVF
    bool
    default y if TEST_DEVICES
    depends on PCI && MSI_NONBROKEN

config AMD8111E
    bool
    default y if TEST_DEVICES
    depends on PCI && MSI_NONBROKEN

config 4XXX
    bool
    default y if TEST_DEVICES
    depends on PCI && MSI_NONBROKEN

config EFCT
    bool
    default y if TEST_DEVICES
    depends on PCI && MSI_NONBROKEN

config SOF_AUDIO_PCI_INTEL_SKL
    bool
    default y if TEST_DEVICES
    depends on PCI && MSI_NONBROKEN

config AIC94XX
    bool
    default y if TEST_DEVICES
    depends on PCI && MSI_NONBROKEN

config CB_PCIDAS
    bool
    default y if TEST_DEVICES
    depends on PCI && MSI_NONBROKEN

config IAVF
    bool
    default y if TEST_DEVICES
    depends on PCI && MSI_NONBROKEN

config SATA_NV
    bool
    default y if TEST_DEVICES
    depends on PCI && MSI_NONBROKEN

config PM80XX
    bool
    default y if TEST_DEVICES
    depends on PCI && MSI_NONBROKEN

config B2C2_FLEXCOP_PCI
    bool
    default y if TEST_DEVICES
    depends on PCI && MSI_NONBROKEN

config CASSINI
    bool
    default y if TEST_DEVICES
    depends on PCI && MSI_NONBROKEN

config C3XXX
    bool
    default y if TEST_DEVICES
    depends on PCI && MSI_NONBROKEN

config 8139CP
    bool
    default y if TEST_DEVICES
    depends on PCI && MSI_NONBROKEN

config ACARD_AHCI
    bool
    default y if TEST_DEVICES
    depends on PCI && MSI_NONBROKEN

config ML_IOH_GPIO
    bool
    default y if TEST_DEVICES
    depends on PCI && MSI_NONBROKEN

config AIC79XX
    bool
    default y if TEST_DEVICES
    depends on PCI && MSI_NONBROKEN

config SOF_AUDIO_PCI_INTEL_TNG
    bool
    default y if TEST_DEVICES
    depends on PCI && MSI_NONBROKEN

config ATA_PIIX
    bool
    default y if TEST_DEVICES
    depends on PCI && MSI_NONBROKEN

config ATY128FB
    bool
    default y if TEST_DEVICES
    depends on PCI && MSI_NONBROKEN

config 3C59X
    bool
    default y if TEST_DEVICES
    depends on PCI && MSI_NONBROKEN

config E1000
    bool
    default y if TEST_DEVICES
    depends on PCI && MSI_NONBROKEN

config LXFB
    bool
    default y if TEST_DEVICES
    depends on PCI && MSI_NONBROKEN

config ATYFB
    bool
    default y if TEST_DEVICES
    depends on PCI && MSI_NONBROKEN

config IOSF_MBI_PCI
    bool
    default y if TEST_DEVICES
    depends on PCI && MSI_NONBROKEN

config DL2K
    bool
    default y if TEST_DEVICES
    depends on PCI && MSI_NONBROKEN

config FEALNX
    bool
    default y if TEST_DEVICES
    depends on PCI && MSI_NONBROKEN

config EXAR_SERIAL
    bool
    default y if TEST_DEVICES
    depends on PCI && MSI_NONBROKEN

config 8250_LPSS
    bool
    default y if TEST_DEVICES
    depends on PCI && MSI_NONBROKEN

config BTTV
    bool
    default y if TEST_DEVICES
    depends on PCI && MSI_NONBROKEN

config E100
    bool
    default y if TEST_DEVICES
    depends on PCI && MSI_NONBROKEN

config CDNS2_PCI
    bool
    default y if TEST_DEVICES
    depends on PCI && MSI_NONBROKEN

config INTEL_QEP
    bool
    default y if TEST_DEVICES
    depends on PCI && MSI_NONBROKEN

config MOXA
    bool
    default y if TEST_DEVICES
    depends on PCI && MSI_NONBROKEN

config DC395X
    bool
    default y if TEST_DEVICES
    depends on PCI && MSI_NONBROKEN

config PDC_ADMA
    bool
    default y if TEST_DEVICES
    depends on PCI && MSI_NONBROKEN

config CX18
    bool
    default y if TEST_DEVICES
    depends on PCI && MSI_NONBROKEN

config BT878
    bool
    default y if TEST_DEVICES
    depends on PCI && MSI_NONBROKEN

config PATA_ATIIXP
    bool
    default y if TEST_DEVICES
    depends on PCI && MSI_NONBROKEN

config PM2FB
    bool
    default y if TEST_DEVICES
    depends on PCI && MSI_NONBROKEN

config COMPAT
    bool
    default y if TEST_DEVICES
    depends on PCI && MSI_NONBROKEN

config CX88_AUDIO
    bool
    default y if TEST_DEVICES
    depends on PCI && MSI_NONBROKEN

config PCNET32
    bool
    default y if TEST_DEVICES
    depends on PCI && MSI_NONBROKEN

config AHCI
    bool
    default y if TEST_DEVICES
    depends on PCI && MSI_NONBROKEN

config DT3155
    bool
    default y if TEST_DEVICES
    depends on PCI && MSI_NONBROKEN
    
config EC_BHF
    bool
    default y if TEST_DEVICES
    depends on PCI && MSI_NONBROKEN

config AECTC
    bool
    default y if TEST_DEVICES
    depends on PCI && MSI_NONBROKEN
    
config RDC321X
    bool
    default y if TEST_DEVICES
    depends on PCI && MSI_NONBROKEN
        
config SNET_VDPA
    bool
    default y if TEST_DEVICES
    depends on PCI && MSI_NONBROKEN
        
config NS83820
    bool
    default y if TEST_DEVICES
    depends on PCI && MSI_NONBROKEN

config ULI526X
    bool
    default y if TEST_DEVICES
    depends on PCI && MSI_NONBROKEN

config SOF_AUDIO_PCI_INTEL_CNL
    bool
    default y if TEST_DEVICES
    depends on PCI && MSI_NONBROKEN

config PATA_SIL680
    bool
    default y if TEST_DEVICES
    depends on PCI && MSI_NONBROKEN
```
